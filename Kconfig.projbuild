## Kconfig.projbuild
```kconfig
menu "LoRaCue Configuration"

    choice LORACUE_MODEL
        prompt "Product Model"
        default MODEL_LC_ALPHA
        help
            Select the LoRaCue product model.
            Each model has a specific hardware configuration.
        
        config MODEL_LC_ALPHA
            bool "LC-Alpha (Heltec V3, 1 button)"
            select BOARD_HELTEC_V3
            select UI_MINI
            select BUTTON_MODE_SINGLE
            help
                Prototype model with Heltec LoRa V3 board.
                Uses single onboard button (GPIO0).
        
        config MODEL_LC_ALPHA_PLUS
            bool "LC-Alpha+ (Heltec V3, 2 buttons)"
            select BOARD_HELTEC_V3
            select UI_MINI
            select BUTTON_MODE_DUAL
            help
                Enhanced prototype with Heltec LoRa V3 board.
                Uses two separate external buttons (prev/next).
        
        config MODEL_LC_GAMMA
            bool "LC-Gamma (LilyGO T5 Pro, E-paper)"
            select BOARD_LILYGO_T5
            select UI_RICH
            select TOUCH_ENABLED
            select EINK_DISPLAY
            help
                Professional model with LilyGO T5 4.7" E-paper display.
                Features touch interface and rich UI.
    endchoice

    config LORACUE_MODEL_NAME
        string
        default "LC-Alpha" if MODEL_LC_ALPHA
        default "LC-Alpha+" if MODEL_LC_ALPHA_PLUS
        default "LC-Gamma" if MODEL_LC_GAMMA

    # Board selection (implicit, set by model)
    config BOARD_HELTEC_V3
        bool
    
    config BOARD_LILYGO_T5
        bool

    config LORACUE_BOARD_ID
        string
        default "heltec_v3" if BOARD_HELTEC_V3
        default "lilygo_t5" if BOARD_LILYGO_T5

    # UI selection (implicit, set by model)
    config UI_MINI
        bool
    
    config UI_RICH
        bool

    # Button configuration
    config BUTTON_MODE_SINGLE
        bool

    config BUTTON_MODE_DUAL
        bool

    config BUTTON_GPIO
        int "Single button GPIO"
        default 0
        depends on BUTTON_MODE_SINGLE

    config BUTTON_PREV_GPIO
        int "Previous button GPIO"
        default 12
        depends on BUTTON_MODE_DUAL

    config BUTTON_NEXT_GPIO
        int "Next button GPIO"
        default 13
        depends on BUTTON_MODE_DUAL

    # Display configuration
    config TOUCH_ENABLED
        bool

    config EINK_DISPLAY
        bool

endmenu
```

## components/bsp/Kconfig
```kconfig
menu "Board Support Package (BSP)"

    config BSP_I2C_CLOCK_SPEED_HZ
        int "I2C Clock Speed (Hz)"
        default 400000
        range 100000 1000000
        help
            I2C bus clock speed in Hz.
            
            Common values:
            - 100000 (100kHz) - Standard mode
            - 400000 (400kHz) - Fast mode (recommended)
            - 1000000 (1MHz) - Fast mode plus (if supported)
            
            Note: Higher speeds may not work with all I2C devices.
            Check your hardware specifications before changing.

endmenu
```

## components/i2console/examples/esp-idf/components/i2console/Kconfig
```kconfig
menu "I2Console Configuration"

    config I2CONSOLE_ENABLED
        bool "Enable I2Console"
        default y
        help
            Enable I2Console component for I2C to USB-CDC console bridge.

    config I2CONSOLE_I2C_ADDRESS
        hex "I2Console I2C Address"
        default 0x37
        range 0x08 0x77
        depends on I2CONSOLE_ENABLED
        help
            I2C slave address of I2Console device (default: 0x37).

endmenu
```

## components/input_manager/Kconfig
```kconfig
menu "Input Manager"

    config LORACUE_INPUT_HAS_DUAL_BUTTONS
        bool
        default y if LORACUE_MODEL_ALPHA_PLUS || LORACUE_MODEL_BETA
        default n
        help
            Enable dual button support (PREV + NEXT buttons).
            Automatically enabled for Alpha+ and Beta models.

    config LORACUE_INPUT_HAS_ENCODER
        bool
        default y if LORACUE_MODEL_ALPHA_PLUS || LORACUE_MODEL_BETA
        default n
        help
            Enable rotary encoder support.
            Automatically enabled for Alpha+ and Beta models.

    config LORACUE_INPUT_DEBOUNCE_MS
        int "Button debounce time (ms)"
        default 50
        range 10 200
        help
            Debounce time for button presses in milliseconds.

    config LORACUE_INPUT_LONG_PRESS_MS
        int "Long press threshold (ms)"
        default 1000
        range 500 3000
        help
            Time threshold for detecting long press in milliseconds.

    config LORACUE_INPUT_DOUBLE_PRESS_MS
        int "Double press window (ms)"
        default 300
        range 100 500
        help
            Maximum time between presses to detect double press.

endmenu
```

## components/lora/Kconfig
```kconfig
menu "LoRa Protocol Configuration"

    config LORA_SEND_RELIABLE
        bool "Enable reliable transmission with ACK"
        default n
        help
            Enable reliable transmission mode in presenter mode.
            When enabled, presenter waits for ACK from PC with retries.
            When disabled, presenter sends fire-and-forget for lower latency.
            PC mode always sends ACKs regardless of this setting.

endmenu
```

## components/sx126x/Kconfig.projbuild
```kconfig
menu "SX126X Configuration"

	config LORACUE_SX126X_GPIO_RANGE_MAX
		int
		default 33 if IDF_TARGET_ESP32
		default 46 if IDF_TARGET_ESP32S2
		default 48 if IDF_TARGET_ESP32S3
		default 18 if IDF_TARGET_ESP32C2
		default 19 if IDF_TARGET_ESP32C3
		default 30 if IDF_TARGET_ESP32C6

	choice LORACUE_SX126X_FREQUENCY
		prompt "Frequency to use"
		default LORACUE_SX126X_433MHZ
		help
			Select Frequency to use.
		config LORACUE_SX126X_433MHZ
			bool "433MHz"
			help
				Frequency is 433MHz.
		config LORACUE_SX126X_866MHZ
			bool "866MHz"
			help
				Frequency is 866MHz.
		config LORACUE_SX126X_915MHZ
			bool "915MHz"
			help
				Frequency is 915MHz.
		config LORACUE_SX126X_OTHER
			bool "Other"
			help
				Other Frequency.
	endchoice

	config LORACUE_SX126X_OTHER_FREQUENCY
		depends on LORACUE_SX126X_OTHER
		int "Frequency to use[MHz]"
		range 1 999
		default 433
		help
			Frequency to use[MHz].

	config LORACUE_SX126X_ADVANCED
		bool "Enable Advanced settings"
		default false
		help
			Enable Advanced settings.

	config LORACUE_SX126X_CODING_RATE
		depends on LORACUE_SX126X_ADVANCED
		int "Error coding rate"
		range 1 4
		default 1
		help
			Error coding rate.

	config LORACUE_SX126X_BANDWIDTH
		depends on LORACUE_SX126X_ADVANCED
		int "Signal Bandwidth"
		range 0 6
		default 4
		help
			Signal Bandwidth.

	config LORACUE_SX126X_SF_RATE
		depends on LORACUE_SX126X_ADVANCED
		int "Spreading Factor"
		range 5 12
		default 7
		help
			Spreading Factor.

	config LORACUE_SX126X_USE_TCXO
		bool "Enable TCXO"
		default false
		help
			Enable Temperature-Compensated Crystal Oscillator.

	config LORACUE_SX126X_MISO_GPIO
		int "SX126X MISO GPIO"
		range 0 LORACUE_SX126X_GPIO_RANGE_MAX
		default 19 if IDF_TARGET_ESP32
		default 11 if IDF_TARGET_ESP32S3
		default 37 if IDF_TARGET_ESP32S2
		default  4 # C3 and others
		help
			Pin Number to be used as the MISO SPI signal.

	config LORACUE_SX126X_SCLK_GPIO
		int "SX126X SCLK GPIO"
		range 0 LORACUE_SX126X_GPIO_RANGE_MAX
		default 18 if IDF_TARGET_ESP32
		default 9 if IDF_TARGET_ESP32S3
		default 36 if IDF_TARGET_ESP32S2
		default  5 # C3 and others
		help
			Pin Number to be used as the SCLK SPI signal.

	config LORACUE_SX126X_MOSI_GPIO
		int "SX126X MOSI GPIO"
		range 0 LORACUE_SX126X_GPIO_RANGE_MAX
		default 23 if IDF_TARGET_ESP32
		default 10 if IDF_TARGET_ESP32S3
		default 35 if IDF_TARGET_ESP32S2
		default  6 # C3 and others
		help
			Pin Number to be used as the MOSI SPI signal.

	config LORACUE_SX126X_NSS_GPIO
		int "SX126X NSS GPIO"
		range 0 LORACUE_SX126X_GPIO_RANGE_MAX
		default 15 if IDF_TARGET_ESP32
		default 8 if IDF_TARGET_ESP32S3
		default 34 if IDF_TARGET_ESP32S2
		default  7 # C3 and others
		help
			Pin Number to be used as the NSS SPI signal.

	config LORACUE_SX126X_RST_GPIO
		int "SX126X RST GPIO"
		range 0 LORACUE_SX126X_GPIO_RANGE_MAX
		default 16 if IDF_TARGET_ESP32
		default 12 if IDF_TARGET_ESP32S3
		default 38 if IDF_TARGET_ESP32S2
		default  2 # C3 and others
		help
			Pin Number to be used as the RST signal.

	config LORACUE_SX126X_BUSY_GPIO
		int "SX126X BUSY GPIO"
		range 0 LORACUE_SX126X_GPIO_RANGE_MAX
		default 17 if IDF_TARGET_ESP32
		default 13 if IDF_TARGET_ESP32S3
		default 39 if IDF_TARGET_ESP32S2
		default  3 # C3 and others
		help
			Pin Number to be used as the BUSY signal.

	config LORACUE_SX126X_TXEN_GPIO
		int "SX126X TXEN GPIO"
		range -1 LORACUE_SX126X_GPIO_RANGE_MAX
		default -1
		help
			Pin Number to be used as the TXEN signal.

	config LORACUE_SX126X_RXEN_GPIO
		int "SX126X RXEN GPIO"
		range -1 LORACUE_SX126X_GPIO_RANGE_MAX
		default -1
		help
			Pin Number to be used as the RXEN signal.

	choice LORACUE_SX126X_SPI_HOST
		prompt "SPI peripheral that controls this bus"
		default LORACUE_SX126X_SPI2_HOST
		help
			Select SPI peripheral that controls this bus.
		config LORACUE_SX126X_SPI2_HOST
			bool "SPI2_HOST"
			help
				Use SPI2_HOST. This is also called HSPI_HOST.
		config LORACUE_SX126X_SPI3_HOST
			depends on IDF_TARGET_ESP32 || IDF_TARGET_ESP32S2 || IDF_TARGET_ESP32S3
			bool "SPI3_HOST"
			help
				USE SPI3_HOST. This is also called VSPI_HOST
	endchoice

endmenu
```

## components/uart_commands/Kconfig
```kconfig
menu "UART Commands Configuration"

    config LORACUE_UART_COMMANDS_ENABLED
        bool "Enable UART command interface"
        default n
        help
            Enable command interface over hardware UART.
            
            Baudrate: 460800, 8N1
            
            Production: UART0 (TX=GPIO43, RX=GPIO44)
            Debug: UART1 (TX=GPIO2, RX=GPIO3)

    config LORACUE_UART_COMMANDS_PORT_NUM
        int "UART port number for commands"
        depends on LORACUE_UART_COMMANDS_ENABLED
        range 0 2
        default 0
        help
            Select which UART port to use for command interface:
            - 0: UART0 (production - GPIO43/44)
            - 1: UART1 (debug - GPIO2/3, avoids console conflict)
            - 2: UART2 (alternative)

endmenu
```

## main/Kconfig.projbuild
```kconfig
menu "LoRaCue Configuration"

    choice LORACUE_MODEL
        prompt "Product Model"
        default LORACUE_MODEL_ALPHA_PLUS
        help
            Select the LoRaCue product model.
            Each model has a specific hardware configuration.
        
        config LORACUE_MODEL_ALPHA
            bool "LC-Alpha (Heltec V3, 1 button)"
            select BOARD_HELTEC_V3
            select LORACUE_UI_COMPACT
            select LORACUE_BUTTON_MODE_SINGLE
            help
                Prototype model with Heltec LoRa V3 board.
                Uses single onboard button (GPIO0).
        
        config LORACUE_MODEL_ALPHA_PLUS
            bool "LC-Alpha+ (Heltec V3, 2 buttons)"
            select BOARD_HELTEC_V3
            select LORACUE_UI_COMPACT
            select LORACUE_BUTTON_MODE_DUAL
            help
                Enhanced prototype with Heltec LoRa V3 board.
                Uses two separate external buttons (prev/next).
        
        config LORACUE_MODEL_BETA
            bool "LC-Beta (LilyGO T3-S3, E-paper)"
            select BOARD_LILYGO_T3
            select LORACUE_UI_COMPACT
            select EINK_DISPLAY
            select LORACUE_BUTTON_MODE_DUAL
            help
                Compact model with LilyGO T3-S3 2.13" E-paper display.
        
        config LORACUE_MODEL_GAMMA
            bool "LC-Gamma (LilyGO T5 Pro, E-paper)"
            select BOARD_LILYGO_T5
            select LORACUE_UI_RICH
            select TOUCH_ENABLED
            select EINK_DISPLAY
            help
                Professional model with LilyGO T5 4.7" E-paper display.
                Features touch interface and rich UI.
    endchoice

    config LORACUE_MODEL_NAME
        string
        default "LC-Alpha" if LORACUE_MODEL_ALPHA
        default "LC-Alpha+" if LORACUE_MODEL_ALPHA_PLUS
        default "LC-Beta" if LORACUE_MODEL_BETA
        default "LC-Gamma" if LORACUE_MODEL_GAMMA

    # Board selection (implicit, set by model)
    config BOARD_HELTEC_V3
        bool
    
    config BOARD_LILYGO_T3
        bool

    config BOARD_LILYGO_T5
        bool

    config LORACUE_BOARD_ID
        string
        default "heltec_v3" if BOARD_HELTEC_V3
        default "lilygo_t3" if BOARD_LILYGO_T3
        default "lilygo_t5" if BOARD_LILYGO_T5

    # UI selection (implicit, set by model)
    config LORACUE_UI_COMPACT
        bool
    
    config LORACUE_UI_RICH
        bool

    # Button configuration
    config LORACUE_BUTTON_MODE_SINGLE
        bool

    config LORACUE_BUTTON_MODE_DUAL
        bool

    config LORACUE_BUTTON_GPIO
        int "Single button GPIO"
        default 0
        depends on LORACUE_BUTTON_MODE_SINGLE

    config LORACUE_BUTTON_PREV_GPIO
        int "Previous button GPIO"
        default 12
        depends on LORACUE_BUTTON_MODE_DUAL

    config LORACUE_BUTTON_NEXT_GPIO
        int "Next button GPIO"
        default 13
        depends on LORACUE_BUTTON_MODE_DUAL

    # Display configuration
    config TOUCH_ENABLED
        bool

    config EINK_DISPLAY
        bool

endmenu
```

## sdkconfig.defaults
```kconfig
# Partition Table
CONFIG_PARTITION_TABLE_CUSTOM=y
CONFIG_PARTITION_TABLE_CUSTOM_FILENAME="partitions.csv"
CONFIG_PARTITION_TABLE_FILENAME="partitions.csv"

# TinyUSB Configuration
CONFIG_TINYUSB_CDC_ENABLED=y
CONFIG_TINYUSB_HID_COUNT=1


# ESP32-S3 Configuration
CONFIG_IDF_TARGET="esp32s3"
CONFIG_IDF_TARGET_ESP32S3=y


# Bluetooth Configuration - NimBLE BLE 5.0
CONFIG_BT_ENABLED=y
CONFIG_BT_NIMBLE_ENABLED=y

# BLE 5.0 Features
CONFIG_BT_NIMBLE_50_FEATURE_SUPPORT=y
CONFIG_BT_NIMBLE_EXT_ADV=y
CONFIG_BT_NIMBLE_ENABLE_CONN_REATTEMPT=y

# LE Secure Connections (BLE 4.2+ security)
CONFIG_BT_NIMBLE_SM_LEGACY=n
CONFIG_BT_NIMBLE_SM_SC=y
CONFIG_BT_NIMBLE_SECURITY_ENABLE=y

# Memory optimization (single connection for OTA)
CONFIG_BT_NIMBLE_MAX_CONNECTIONS=1
CONFIG_BT_NIMBLE_TRANSPORT_ACL_FROM_LL_COUNT=12
CONFIG_BT_NIMBLE_TRANSPORT_ACL_SIZE=255

# Power Management
CONFIG_PM_ENABLE=y

# Interrupt Watchdog - increase timeout for OTA flash operations
CONFIG_ESP_INT_WDT_TIMEOUT_MS=1000

# LVGL Configuration (v9)
CONFIG_LV_COLOR_DEPTH_16=y
CONFIG_LV_USE_LOG=y
CONFIG_LV_LOG_LEVEL_WARN=y
CONFIG_LV_FONT_MONTSERRAT_8=y
CONFIG_LV_FONT_MONTSERRAT_14=y
CONFIG_LV_FONT_UNSCII_8=y

# mbedTLS - Disable hardware AES to avoid memory allocation contention
CONFIG_MBEDTLS_HARDWARE_AES=n
CONFIG_MBEDTLS_AES_USE_INTERRUPT=n
```
